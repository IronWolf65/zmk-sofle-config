## boards/shields/sofle_mod/Kconfig.defconfig
```kconfig
#-----------------------------------------------------
if SHIELD_SOFLE_MOD_LEFT

config ZMK_SPLIT_ROLE_CENTRAL
    default y

config ZMK_STUDIO
    default y

config ZMK_POINTING_SMOOTH_SCROLLING
    default y

endif #SHIELD_SOFLE_MOD_LEFT
#-----------------------------------------------------
if SHIELD_SOFLE_MOD_RIGHT

config INPUT_TPS43
    default y

endif #SHIELD_SOFLE_MOD_RIGHT
#-----------------------------------------------------

if SHIELD_SOFLE_MOD_LEFT || SHIELD_SOFLE_MOD_RIGHT

config ZMK_POINTING
    default y

config I2C
    default y

if ZMK_DISPLAY

config SSD1306
    default y

endif #ZMK_DISPLAY

if LVGL

config LV_Z_VDB_SIZE
    default 64
config LV_DPI_DEF
    default 148
config LV_Z_BITS_PER_PIXEL
    default 1
choice LV_COLOR_DEPTH
    default LV_COLOR_DEPTH_1
endchoice

endif #LVGL

endif #SHIELD_SOFLE_MOD_LEFT || SHIELD_SOFLE_MOD_RIGHT
```

## boards/shields/sofle_mod/Kconfig.shield
```kconfig
config SHIELD_SOFLE_MOD_LEFT
    def_bool $(shields_list_contains,sofle_mod_left)

config SHIELD_SOFLE_MOD_RIGHT
    def_bool $(shields_list_contains,sofle_mod_right)
```

## config/west.yml
```yaml
manifest:
  remotes:
    - name: zmkfirmware
      url-base: https://github.com/zmkfirmware
      ####
    - name: mctechnology17
      url-base: https://github.com/mctechnology17
    - name: geeksville
      url-base: https://github.com/geeksville
  projects:
    - name: zmk
      remote: zmkfirmware
      revision: v0.3
      import: app/west.yml
      ####
    - name: zmk-nice-oled
      remote: mctechnology17
      revision: main
    - name: zmk_driver_azoteq
      remote: geeksville
      revision: master
  self:
    path: config
```
